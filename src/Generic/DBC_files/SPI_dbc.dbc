VERSION "9"

NS_ :

BS_:

BU_: Host DSP

BO_ 2147483744 OP_Msg_0x60: 35 Host
 SG_ SPI_O_P_SIG_1 : 135|8@1+ (0.1,-10) [-10|10] "m/s2"  DSP
 SG_ reserved3 : 143|4@1+ (1,0) [0|0] "NA"  DSP
 SG_ SPI_Op_SIG_2 : 147|1@1+ (1,0) [0|1] "bool"  DSP
 SG_ SPI_OP_SIG_3 : 148|8@1+ (1,0) [0|2] "ENUM"  DSP
 SG_ SPI_O_P_SIG_10 : 156|8@1+ (1,0) [0|2] "ENUM"  DSP

BO_ 2147483750 IP_Msg_0x66: 60 DSP
 SG_ FS_I_P_SIG_6 : 460|7@1+ (1,0) [0|99] "ratio" Host
 SG_ FS_IP_SIG_9 : 467|1@1+ (1,0) [0|1] "bool" Host
 SG_ FS_ip_siG_5 : 468|7@1+ (1,0) [0|99] "ratio" Host
 SG_ FS_IP_SIG_11 : 475|1@1+ (1,0) [0|1] "bool" Host
 SG_ reserved2 : 476|4@1+ (1,0) [0|0] "NA" Host

BO_ 2147483756 IP_Msg_0x6C: 69 DSP
 SG_ Zero_byte : 0|8@1+ (1,0) [0|0] "NA" Host
 SG_ Reserved_03 : 550|2@1+ (1,0) [0|0] "NA" Host

BO_ 2147483746 OB_Msg_0x62: 789 DSP
 SG_ Axdb_3_D_0 : 532|14@1- (0.0002,0) [-1|1] "rad" Host
 SG_ Axdb_3_D_1 : 1052|14@1- (0.0002,0) [-1|1] "rad" Host
 SG_ Axdb_3_D_2 : 1572|14@1- (0.0002,0) [-1|1] "rad" Host
 SG_ Axdb_3_D_3 : 2092|14@1- (0.0002,0) [-1|1] "rad" Host
 SG_ Axdb_3_D_4 : 2612|14@1- (0.0002,0) [-1|1] "rad" Host
 SG_ Axdb_3_D_5 : 3132|14@1- (0.0002,0) [-1|1] "rad" Host
 SG_ Axdb_3_D_6 : 3652|14@1- (0.0002,0) [-1|1] "rad" Host
 SG_ Axdb_3_D_7 : 4172|14@1- (0.0002,0) [-1|1] "rad" Host
 SG_ Axdb_3_D_8 : 4692|14@1- (0.0002,0) [-1|1] "rad" Host
 SG_ Axdb_3_D_9 : 5212|14@1- (0.0002,0) [-1|1] "rad" Host
 SG_ Axdb_3_D_10 : 5732|14@1- (0.0002,0) [-1|1] "rad" Host
 SG_ Axdb_3_D_11 : 6252|14@1- (0.0002,0) [-1|1] "rad" Host
 SG_ Ab_L_V_STD_11 : 6266|12@1+ (7.32600732600733E-03,0) [0|30] "m/s" Host
 SG_ Ab_L_V_8 : 6278|10@1+ (5.86510263929619E-03,0) [0|6] "m/s" Host
 SG_ An_B_5 : 6288|16@1+ (0.0002,-1.571) [-1.571|1.571] "rad " Host
 SG_ Re_M_11 : 6304|8@1+ (1,0) [0|0] "NA" Host
